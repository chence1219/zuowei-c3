## components/vb6824/Kconfig
```kconfig
menu "VB6824"
	choice VB6824_TYPE
    prompt "VB6924"
    default VB6824_TYPE_OPUS_16K_20MS_PCM_16K
    help
        VB6824支持的类型
    config VB6824_TYPE_PCM_16K
        depends on !IDF_TARGET_ESP32C2
        bool "PCM 16K"
    config VB6824_TYPE_OPUS_16K_20MS_PCM_16K
        bool "OPUS 16K 20ms(input) + PCM 16K(output)"
	endchoice
endmenu
```

## third_party/blufi_app/sdkconfig.defaults
```kconfig
CONFIG_PARTITION_TABLE_CUSTOM=y
CONFIG_PARTITION_TABLE_CUSTOM_FILENAME="partitions.csv"

#
# BT config
#
CONFIG_BT_ENABLED=y
CONFIG_BT_GATTC_ENABLE=n
CONFIG_BT_BLE_SMP_ENABLE=n
CONFIG_BT_BLE_BLUFI_ENABLE=y
CONFIG_BT_BLE_42_FEATURES_SUPPORTED=y
CONFIG_BT_BLE_50_FEATURES_SUPPORTED=n
CONFIG_MBEDTLS_HARDWARE_MPI=n
CONFIG_MBEDTLS_DHM_C=y

#wifi
CONFIG_WIFI_CONFIG_MODE_SSID_PREFIX="xiaopai"

CONFIG_ESP_WIFI_STATIC_TX_BUFFER_NUM=8
CONFIG_ESP_WIFI_CACHE_TX_BUFFER_NUM=16
CONFIG_MAIN_TASK_STACK_SIZE=8192
CONFIG_ESP_SYSTEM_EVENT_QUEUE_SIZE=32
CONFIG_ESP_SYSTEM_EVENT_TASK_STACK_SIZE=4096

#SPIRAM
CONFIG_SPIRAM=y
CONFIG_SPIRAM_MODE_OCT=y
CONFIG_SPIRAM_SPEED_80M=y
CONFIG_SPIRAM_MALLOC_ALWAYSINTERNAL=512
#CONFIG_SPIRAM_MALLOC_RESERVE_INTERNAL=65536
CONFIG_SPIRAM_MEMTEST=n
#CONFIG_MBEDTLS_EXTERNAL_MEM_ALLOC=y

#flash
CONFIG_ESPTOOLPY_FLASHSIZE_16MB=y

#tcp
CONFIG_LWIP_TCP_OOSEQ_MAX_PBUFS=10
CONFIG_ESP_WIFI_STATIC_RX_BUFFER_NUM=16
CONFIG_ESP_WIFI_DYNAMIC_RX_BUFFER_NUM=64
CONFIG_ESP_WIFI_AMPDU_RX_ENABLED=y
CONFIG_ESP_WIFI_RX_BA_WIN=32
CONFIG_LWIP_TCP_WND_DEFAULT=28800
CONFIG_LWIP_TCP_RECVMBOX_SIZE=64
CONFIG_LWIP_TCPIP_RECVMBOX_SIZE=64

#lvgl
CONFIG_LV_USE_SNAPSHOT=y
CONFIG_LV_USE_IMGFONT=y
CONFIG_LV_USE_OBSERVER=y
CONFIG_LV_FONT_FMT_TXT_LARGE=y

#button
CONFIG_SOC_ADC_SUPPORTED=y
```

## third_party/blufi_app/sdkconfig.defaults.esp32p4
```kconfig
# ESP32-P4 specific configuration
# P4 uses ESP-Hosted with external ESP32-C6 as WiFi module

CONFIG_PARTITION_TABLE_CUSTOM=y
CONFIG_PARTITION_TABLE_CUSTOM_FILENAME="partitions.csv"

#
# ESP-Hosted Configuration (P4 as Host, C6 as WiFi Slave)
#
CONFIG_ESP_HOSTED_HOST=y
# Enable WiFi Remote for P4 (via ESP-Hosted)
CONFIG_ESP_WIFI_REMOTE_ENABLED=y

#
# BT config - P4 doesn't have BT, use C6's BT via Hosted
#
# Note: BluFi may need special handling on P4
# For now, disable native BT as P4 doesn't have it
CONFIG_BT_ENABLED=n

# SSID prefix for WiFi config mode
CONFIG_WIFI_CONFIG_MODE_SSID_PREFIX="xiaopai"

# Main task stack
CONFIG_ESP_MAIN_TASK_STACK_SIZE=8192
CONFIG_ESP_SYSTEM_EVENT_QUEUE_SIZE=32
CONFIG_ESP_SYSTEM_EVENT_TASK_STACK_SIZE=4096

#
# PSRAM - P4 uses different PSRAM config
#
CONFIG_SPIRAM=y
CONFIG_SPIRAM_MODE_HEX=y
CONFIG_SPIRAM_SPEED_200M=y
CONFIG_SPIRAM_MALLOC_ALWAYSINTERNAL=512
CONFIG_SPIRAM_MEMTEST=n

#
# Flash
#
CONFIG_ESPTOOLPY_FLASHSIZE_16MB=y

#
# TCP/IP & WiFi (via ESP-Hosted)
#
CONFIG_LWIP_TCP_OOSEQ_MAX_PBUFS=10
CONFIG_ESP_WIFI_STATIC_RX_BUFFER_NUM=6
CONFIG_ESP_WIFI_DYNAMIC_RX_BUFFER_NUM=8
CONFIG_ESP_WIFI_DYNAMIC_RX_MGMT_BUFFER=y
CONFIG_ESP_WIFI_IRAM_OPT=n
CONFIG_ESP_WIFI_RX_IRAM_OPT=n
CONFIG_LWIP_TCP_WND_DEFAULT=28800
CONFIG_LWIP_TCP_RECVMBOX_SIZE=64
CONFIG_LWIP_TCPIP_RECVMBOX_SIZE=64

#
# LVGL
#
CONFIG_LV_USE_SNAPSHOT=y
CONFIG_LV_USE_IMGFONT=y
CONFIG_LV_USE_OBSERVER=y
CONFIG_LV_FONT_FMT_TXT_LARGE=y

#
# Compiler optimizations
#
CONFIG_COMPILER_OPTIMIZATION_SIZE=y
CONFIG_COMPILER_CXX_EXCEPTIONS=y
CONFIG_COMPILER_CXX_EXCEPTIONS_EMG_POOL_SIZE=1024
CONFIG_COMPILER_CXX_RTTI=y

#
# MbedTLS
#
CONFIG_MBEDTLS_DYNAMIC_BUFFER=y
CONFIG_MBEDTLS_SSL_KEEP_PEER_CERTIFICATE=n
CONFIG_MBEDTLS_SSL_RENEGOTIATION=n

#
# HTTP Server
#
CONFIG_HTTPD_MAX_REQ_HDR_LEN=2048
CONFIG_HTTPD_MAX_URI_LEN=2048

#
# Bootloader
#
CONFIG_BOOTLOADER_COMPILER_OPTIMIZATION_PERF=y
CONFIG_BOOTLOADER_LOG_LEVEL_NONE=y
CONFIG_BOOTLOADER_SKIP_VALIDATE_ALWAYS=y
```
