## components/blufi_wificfg/Kconfig
```kconfig
menu "Blufi WifiCfg Configuration"

    config BLUFI_WIFICFG_ENABLED
        bool "blufi wificfg"
        select BT_ENABLED
        select BT_BLE_BLUFI_ENABLE
        help
            enable blufi wificfg

endmenu
```

## components/vb_adapter/Kconfig
```kconfig
menu "VB Adapter"
    menu "UART Settings"
        config VB_UART_PORT
            int "uart num for esp-idf"
            default 1

        config VB_UART_QUEUE_SIZE
            int "UART queue size"
            default 16

        config VB_UART_TX_BUFFER_SIZE
            int "UART TX buffer size (must be greater than 1KB)"
            range 1024 65536
            default 2048

        config VB_UART_RX_BUFFER_SIZE
            int "UART RX buffer size (must be greater than 1KB)"
            range 1024 65536
            default 5120

        config VB_UART_BAUD_RATE
            int "UART baud rate"
            default 2000000

        config VB_UART_TASK_STACK_SIZE
            int "uart task stack size"
            default 3072 if IDF_TARGET_ESP32C2
            default 4096
    endmenu

    config VB_AUDIO_INPUT_FRAME_LEN
        int "Audio input frame length"
        default 40
        help
            一个音频输入帧长度, 默认是40
            
    config VB_AUDIO_OUTPUT_FRAME_LEN
        int "Audio output frame length"
        default 320
        help
            一个音频输出帧长度, 默认是320

    choice
        prompt "Audio Send Method"
        default VB_SEND_USE_TASK
        help
            Select the method for sending audio data: by task or by timer.
        config VB_SEND_USE_TASK
            bool "Send by Task (recommended)"
        config VB_SEND_USE_TIMER
            bool "Send by Timer"
    endchoice

    config VB_SEND_TASK_STACK_SIZE
        int "audio send task stack size"
        depends on VB_SEND_USE_TASK
        default 2048

endmenu
```

## firmware/zuowei_v2/mz19-dqy-c3-v3/00-zuowei-dqy-c3-7014/sdkconfig.defaults.board
```kconfig
CONFIG_BOARD_PATH="../../firmware/zuowei_v2/mz19-dqy-c3-v3/00-zuowei-dqy-c3-7014"
CONFIG_ASSETS_FIX_PATH="../firmware/_common_v2/assets_fix"

CONFIG_PARTITION_TABLE_CUSTOM=y
CONFIG_PARTITION_TABLE_CUSTOM_FILENAME="partitions/v1/8m_modify.csv"
CONFIG_PARTITION_TABLE_FILENAME="partitions/v1/8m_modify.csv"

CONFIG_USE_DEVICE_AEC=y
CONFIG_DEVICE_AEC_DEFAULT_OFF=y

CONFIG_IOT_PROTOCOL_XIAOZHI=n
CONFIG_IOT_PROTOCOL_MCP=y

CONFIG_WIFI_CONFIG_MODE_FORMAT_DISPLAY=y
CONFIG_WIFI_CONFIG_MODE_SSID_PREFIX="zuowei"

CONFIG_SPEAKING_FIRST_MUTE_TIME=60

CONFIG_USE_CUSTOM_OTA=y


# nertc 
CONFIG_OTA_URL="https://nrtc.netease.im/v1/ota"
CONFIG_CONNECTION_TYPE_NERTC=y
CONFIG_USE_MUSIC_PLAYER=y


CONFIG_VB6824_OTA_SUPPORT=n

# 阿拉伯字体处理
#CONFIG_LV_USE_BIDI=y
#CONFIG_LV_BIDI_DIR_AUTO=y
#CONFIG_LV_USE_ARABIC_PERSIAN_CHARS=y

#CONFIG_LV_DRAW_LAYER_SIMPLE_BUF_SIZE=4096

CONFIG_COMPILER_OPTIMIZATION_PERF=n
CONFIG_COMPILER_OPTIMIZATION_SIZE=y

CONFIG_ESP_WIFI_STATIC_RX_BUFFER_NUM=3
CONFIG_ESP_WIFI_DYNAMIC_RX_BUFFER_NUM=6
CONFIG_ESP_WIFI_RX_BA_WIN=6
CONFIG_ESP_WIFI_DYNAMIC_TX_BUFFER_NUM=16

CONFIG_MBEDTLS_DYNAMIC_FREE_CONFIG_DATA=y


CONFIG_ESP_WIFI_ENABLE_WPA3_SAE=y
CONFIG_LWIP_IPV6=y
CONFIG_LWIP_TCPIP_RECVMBOX_SIZE=16

#CONFIG_FREERTOS_IDLE_TASK_STACKSIZE=1536

CONFIG_VB_UART_RX_BUFFER_SIZE=6144

#CONFIG_USE_BLUFI_NET_CONFIGURING=y

CONFIG_BT_NIMBLE_LOW_SPEED_MODE=y

CONFIG_LV_USE_LZ4=y
```

## firmware/zuowei_v2/mz19-dqy-c3-v3/zw-dqy-c3-7014-aec/sdkconfig.defaults.board
```kconfig
CONFIG_BOARD_PATH="../../firmware/zuowei_v2/mz19-dqy-c3-v3/00-zuowei-dqy-c3-7014"
CONFIG_ASSETS_FIX_PATH="../firmware/_common_v2/assets_fix"

CONFIG_USE_DEVICE_AEC=y
CONFIG_DEVICE_AEC_DEFAULT_OFF=n

CONFIG_CUSTOM_BOARD_TYPE="zw-dqy-c3-7014-aec"
CONFIG_WIFI_CONFIG_MODE_SSID_PREFIX="zw-dqy-c3"

## BLUFI配网
CONFIG_BT_ENABLED=y
CONFIG_BT_NIMBLE_ENABLED=y
#CONFIG_BT_NIMBLE_MEM_ALLOC_MODE_EXTERNAL=y
CONFIG_BT_NIMBLE_BLUFI_ENABLE=y
CONFIG_BT_CTRL_RUN_IN_FLASH_ONLY=y
CONFIG_BT_NIMBLE_LOG_LEVEL_NONE=y
CONFIG_BT_NIMBLE_DIS_SERVICE=n
CONFIG_BT_NIMBLE_HR_SERVICE=n
CONFIG_BT_NIMBLE_SPS_SERVICE=n
CONFIG_BT_NIMBLE_LLS_SERVICE=n
CONFIG_BT_NIMBLE_IAS_SERVICE=n
CONFIG_BT_NIMBLE_TPS_SERVICE=n
CONFIG_BT_NIMBLE_IPSS_SERVICE=n
CONFIG_BT_NIMBLE_HTP_SERVICE=n
CONFIG_BT_NIMBLE_CTS_SERVICE=n
CONFIG_BT_NIMBLE_ANS_SERVICE=n
CONFIG_BT_NIMBLE_PROX_SERVICE=n
CONFIG_BT_NIMBLE_ATT_PREFERRED_MTU=256 //mtu过短的话发送ssid列表容易超
CONFIG_USE_BLUFI_NET_CONFIGURING=y
CONFIG_WIFI_CONFIG_MODE_AUTO_DELAY_RELEASE_DECODER_TIME=6000
```

## main/Kconfig.projbuild
```kconfig
menu "Xiaozhi Assistant"

config OTA_URL
    string "Default OTA URL"
    default "https://nrtc.netease.im/v1/ota"
    help
        The application will access this URL to check for new firmwares and server address.

config USE_CUSTOM_OTA
    bool "Use Custom OTA"
    default n
    help
        Enable Custom OTA

config CUSTOM_OTA_VERSION_URL
    depends on USE_CUSTOM_OTA
    string "Custom OTA Version URL"
    default "http://xiaozhi.doit.am/ota/ota.php"
    help
        The application will access this URL to check for updates.

config CONNECTION_FORCE_FIXED_WEBSOCKET
    bool "Force Fixed Websocket"
    default n
    help
        Force Fixed Websocket

config WEBSOCKET_URL
    depends on CONNECTION_FORCE_FIXED_WEBSOCKET
    string "Websocket URL"
    default "wss://api.tenclass.net/xiaozhi/v1/"
    help
        Communication with the server through websocket after wake up.

config WEBSOCKET_ACCESS_TOKEN
    depends on CONNECTION_FORCE_FIXED_WEBSOCKET
    string "Websocket Access Token"
    default "test-token"
    help
        Access token for websocket communication.
choice
    prompt "Flash Assets"
    default FLASH_DEFAULT_ASSETS
    help
        Select the assets to flash.

    config FLASH_NONE_ASSETS
        bool "Do not flash assets"
    config FLASH_DEFAULT_ASSETS
        bool "Flash Default Assets"
    config FLASH_CUSTOM_ASSETS
        bool "Flash Custom Assets"
endchoice

config CONNECTION_TYPE_NERTC
    bool "Enanle NERTC Protocol"
    default y
    help
        使用网易云信传输

config USE_MUSIC_PLAYER
    bool "Enanle NERTC Protocol"
    default y
    help
        网易云音乐播放

config CUSTOM_ASSETS_FILE
    depends on FLASH_CUSTOM_ASSETS
    string "Custom Assets File"
    default "assets.bin"
    help
        The custom assets file to flash.
        It can be a local file relative to the project directory or a remote url.

choice
    prompt "Default Language"
    default LANGUAGE_ZH_CN
    help
        Select device display language

    config LANGUAGE_ZH_CN
        bool "Chinese"
    config LANGUAGE_ZH_TW
        bool "Chinese Traditional"
    config LANGUAGE_EN_US
        bool "English"
    config LANGUAGE_JA_JP
        bool "Japanese"
    config LANGUAGE_KO_KR
        bool "Korean"
    config LANGUAGE_VI_VN
        bool "Vietnamese"
    config LANGUAGE_TH_TH
        bool "Thai"
    config LANGUAGE_DE_DE
        bool "German"
    config LANGUAGE_FR_FR
        bool "French"
    config LANGUAGE_ES_ES
        bool "Spanish"
    config LANGUAGE_IT_IT
        bool "Italian"
    config LANGUAGE_RU_RU
        bool "Russian"
    config LANGUAGE_AR_SA
        bool "Arabic"
    config LANGUAGE_HI_IN
        bool "Hindi"
    config LANGUAGE_PT_PT
        bool "Portuguese"
    config LANGUAGE_PL_PL
        bool "Polish"
    config LANGUAGE_CS_CZ
        bool "Czech"
    config LANGUAGE_FI_FI
        bool "Finnish"
    config LANGUAGE_TR_TR
        bool "Turkish"
    config LANGUAGE_ID_ID
        bool "Indonesian"
    config LANGUAGE_UK_UA
        bool "Ukrainian"
    config LANGUAGE_RO_RO
        bool "Romanian"
endchoice

config BOARD_PATH
    string "Board Path"
    default "../../firmware/doit/doit-ai-01-kit"
    help
        Board Path

config CUSTOM_BOARD_TYPE
    string "custom board type"
    default ""
    help
        自定义板型名称，当存在时就直接用这个名称，而不是用文件夹名称

config ASSETS_PATH
    string "Assets Path"
    default "assets"
    help
        Assets Path

config ASSETS_FIX_PATH
    string "Assets Fix Path"
    default ""
    help
        Assets Fix Path

choice DISPLAY_STYLE
    prompt "Select display style"
    default USE_DEFAULT_MESSAGE_STYLE
    help
        Select display style for Xiaozhi device

    config USE_DEFAULT_MESSAGE_STYLE
        bool "Enable default message style"

    config USE_WECHAT_MESSAGE_STYLE
        bool "Enable WeChat Message Style"

    config USE_EMOTE_MESSAGE_STYLE
        bool "Emote animation style"
        depends on BOARD_TYPE_ESP_BOX_3 || BOARD_TYPE_ECHOEAR
endchoice

choice WAKE_WORD_TYPE
    prompt "Wake Word Implementation Type"
    default USE_AFE_WAKE_WORD if (IDF_TARGET_ESP32S3 || IDF_TARGET_ESP32P4) && SPIRAM
    default WAKE_WORD_DISABLED
    help
        Choose the type of wake word implementation to use

    config WAKE_WORD_DISABLED
        bool "Disabled"
        help
            Disable wake word detection

    config USE_ESP_WAKE_WORD
        bool "Wakenet model without AFE"
        depends on IDF_TARGET_ESP32C3 || IDF_TARGET_ESP32C5 || IDF_TARGET_ESP32C6 || (IDF_TARGET_ESP32 && SPIRAM)
        help
            Support ESP32 C3、ESP32 C5 与 ESP32 C6, and (ESP32 with PSRAM)

    config USE_AFE_WAKE_WORD
        bool "Wakenet model with AFE"
        depends on (IDF_TARGET_ESP32S3 || IDF_TARGET_ESP32P4) && SPIRAM
        help
            Support AEC if available, requires ESP32 S3 and PSRAM

    config USE_CUSTOM_WAKE_WORD
        bool "Multinet model (Custom Wake Word)"
        depends on (IDF_TARGET_ESP32S3 || IDF_TARGET_ESP32P4) && SPIRAM
        help
            Requires ESP32 S3 and PSRAM

endchoice

config CUSTOM_WAKE_WORD
    string "Custom Wake Word"
    default "xiao tu dou"
    depends on USE_CUSTOM_WAKE_WORD
    help
        Custom Wake Word, use pinyin for Chinese, separated by spaces

config CUSTOM_WAKE_WORD_DISPLAY
    string "Custom Wake Word Display"
    default "小土豆"
    depends on USE_CUSTOM_WAKE_WORD
    help
        Greeting sent to the server after wake word detection

config CUSTOM_WAKE_WORD_THRESHOLD
    int "Custom Wake Word Threshold (%)"
    default 20
    range 1 99
    depends on USE_CUSTOM_WAKE_WORD
    help
        Custom Wake Word Threshold, range 1-99, the smaller the more sensitive, default 20

config SEND_WAKE_WORD_DATA
    bool "Send Wake Word Data"
    default y
    depends on USE_AFE_WAKE_WORD || USE_CUSTOM_WAKE_WORD
    help
        Send wake word data to the server as the first message of the conversation and wait for response
        
config USE_AUDIO_PROCESSOR
    bool "Enable Audio Noise Reduction"
    default y
    depends on (IDF_TARGET_ESP32S3 || IDF_TARGET_ESP32P4) && SPIRAM
    help
        Requires ESP32 S3 and PSRAM

config USE_DEVICE_AEC
    bool "Enable Device-Side AEC"
    default n
    help
        因为性能不够，不建议和微信聊天界面风格同时开启
config DEVICE_AEC_DEFAULT_OFF
    bool "Device-Side AEC default off"
    default y
    depends on USE_DEVICE_AEC
    help 
        是否默认开启实时打断模式（默认关闭实时打断）

config USE_SERVER_AEC
    bool "Enable Server-Side AEC (Unstable)"
    default n
    help
        To work perperly, server-side AEC requires server support

config USE_AUDIO_DEBUGGER
    bool "Enable Audio Debugger"
    default n
    help
        Enable audio debugger, send audio data through UDP to the host machine

config AUDIO_DEBUG_UDP_SERVER
    string "Audio Debug UDP Server Address"
    default "192.168.2.100:8000"
    depends on USE_AUDIO_DEBUGGER
    help
        UDP server address, format: IP:PORT, used to receive audio debugging data

config USE_ACOUSTIC_WIFI_PROVISIONING
    bool "Enable Acoustic WiFi Provisioning"
    default n
    help
        Enable acoustic WiFi provisioning, use audio signal to transmit WiFi configuration data

config RECEIVE_CUSTOM_MESSAGE
    bool "Enable Custom Message Reception"
    default n
    help
        Enable custom message reception, allow the device to receive custom messages from the server (preferably through the MQTT protocol)

menu TAIJIPAI_S3_CONFIG
    depends on BOARD_TYPE_ESP32S3_Taiji_Pi
    choice I2S_TYPE_TAIJIPI_S3
        prompt "taiji-pi-S3 I2S Type"
        default TAIJIPAI_I2S_TYPE_STD
        help
            I2S 类型选择
        config TAIJIPAI_I2S_TYPE_STD
            bool "I2S Type STD"
        config TAIJIPAI_I2S_TYPE_PDM
            bool "I2S Type PDM"
    endchoice

    config I2S_USE_2SLOT
    bool "Enable I2S 2 Slot"
    default n
    help
        启动双声道
endmenu

config SPEAKING_FIRST_MUTE_TIME
    int "Time to mute before speaking"
    default 0
    help
        讲话之前静音时间

menu "wifi"
    menu "wifi config mode"
        choice
            prompt "Net Configuration"
            default USE_SOFTAP_NET_CONFIGURING
            help
                Select net configuration

            config USE_SOFTAP_NET_CONFIGURING
                bool "SoftAP"
            config USE_BLUFI_NET_CONFIGURING
                select BLUFI_WIFICFG_ENABLED
                bool "Blufi"
        endchoice

        config WIFI_CONFIG_MODE_SSID_PREFIX
            # depends on USE_SOFTAP_NET_CONFIGURING
            string "wifi config mode ssid prefix"
            default "xiaozhi"

        config WIFI_CONFIG_MODE_FORMAT_DISPLAY
            depends on USE_SOFTAP_NET_CONFIGURING
            bool "wifi config mode format display"
            default n

        config WIFI_CONFIG_MODE_AUTO_DELAY_RELEASE_DECODER_TIME
            int "wifi config mode delay auto release decoder time"
            default -1
    endmenu

    config SLEEP_MODE_IGNORE_WIFI_STATUS
        bool "sleep mode ignore wifi status"
        default n
        help
            进入休眠模式时是否忽略WiFi状态

    config WIFI_WAIT_FOR_CONNECTED_TIME
        int "wifi wait for connected time"
        default 60
        help
            首次等待WiFi连接时间
endmenu

menu "ui"
    config UI_STATUS_BAR_PAD
        int "Status Sar Pad"
        default 2
        help
            状态栏左右间距  
endmenu

config USE_AUDIO_CODEC_ENCODE_OPUS
    select USE_CUSTOM_TASK_STACK_SIZE
    bool "use audio codec encode opus"
    default y

config USE_AUDIO_CODEC_DECODE_OPUS
    select USE_CUSTOM_TASK_STACK_SIZE
    bool "use audio codec decode opus"
    default n

config USE_CUSTOM_TASK_STACK_SIZE
    bool "use custom task stack size"
    default n

config OPUS_CODEC_TASK_STACK_SIZE
    depends on USE_CUSTOM_TASK_STACK_SIZE
    int "opus_codec task stack size"
    default 2048 if ((IDF_TARGET_ESP32C2 || IDF_TARGET_ESP32C3) && (USE_AUDIO_CODEC_ENCODE_OPUS && USE_AUDIO_CODEC_DECODE_OPUS))
    default 8960 if ((IDF_TARGET_ESP32C2 || IDF_TARGET_ESP32C3) && (USE_AUDIO_CODEC_ENCODE_OPUS))
    default 26624 if ((IDF_TARGET_ESP32C2 || IDF_TARGET_ESP32C3))
    default 28672

config AUDIO_INPUT_TASK_STACK_SIZE
    depends on USE_CUSTOM_TASK_STACK_SIZE
    int "audio_input task stack size"
    default 2048 if IDF_TARGET_ESP32C2
    default 6144

config AUDIO_OUTPUT_TASK_STACK_SIZE
    depends on USE_CUSTOM_TASK_STACK_SIZE
    int "audio_output task stack size"
    default 2048 if IDF_TARGET_ESP32C2
    default 4096

config STT_SIMPLIFIED_CHINESE_TO_TRADITIONAL_CHINESE
    bool "STT Simplified Chinese to Traditional Chinese"
    default n
    help
        将语音识别结果从简体中文转换为繁体中文

config START_CHAT_ON_POWER_ON
    bool "start char after power on"
    default n
    help
        在开机后立即开始对话并回复一句话

config ENABLE_CAMERA_SOUND
    bool "是否开启摄像头的拍照音效"
    default n
    help 
        在拍照的时候播放咔嚓音效

endmenu
```

## sdkconfig.defaults.esp32c3
```kconfig
CONFIG_ESPTOOLPY_FLASHSIZE_4MB=y

CONFIG_PARTITION_TABLE_CUSTOM=y
CONFIG_PARTITION_TABLE_CUSTOM_FILENAME="partitions/v1/4m.csv"
CONFIG_PARTITION_TABLE_FILENAME="partitions/v1/4m.csv"
CONFIG_PARTITION_TABLE_OFFSET=0x8000
```
